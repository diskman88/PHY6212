## applications/seneasy/B014-EVT-TEST/defconfig
```kconfig
###############################################################################
#
# Copyright (C) 2017 C-SKY Microsystems Co. All rights reserved.
#
###############################################################################

############################## YoC Libs ###########################
CONFIG_LIBS=drivers yoc_kernel lpm kv cli at csi boards_ch6121 libs bt_host ble_profile drivers_bt ble_dut

#############################YoC Net Driver ###########################
#CONFIG_NET_DRIVER=enc28j60
#CONFIG_NET_DRIVER=esp8266
#CONFIG_NET_DRIVER=sim800c

#############################YoC IoT ###########################
#CONFIG_IOT_LIBS=iot_alimqtt_tls
#CONFIG_IOT_LIBS=iot_alicoap_psk
#CONFIG_IOT_LIBS=iot_alicoap_dtls
#CONFIG_IOT_LIBS=iot_onenet
#CONFIG_IOT_LIBS=iot_lwm2m

################################### Misc #######################################
CONFIG_ARCH_ARM=y
CONFIG_CHIP_VENDOR=phyplus
CONFIG_CHIP_NAME=ch6121
CONFIG_BOARD_NAME=ch6121_evb
CONFIG_CPU_CM0=y
```

## defconfig
```kconfig
###############################################################################
#
# Copyright (C) 2017 C-SKY Microsystems Co. All rights reserved.
#
###############################################################################
#################################### Debug Config #############################
#CONFIG_DEBUG=y
CONFIG_PARAM_NOT_CHECK=y
CONFIG_CLI=y
#CONFIG_WDT=y
# log level 0 disable 1 fatal 2 error 3 warning 4 info 5 debug
CONFIG_LOGLEVEL_DEFAULT=4
############################### Modules Config ###############################
CONFIG_KV_SMART=y
CONFIG_AT=y
#####Please disable CONFIG_DEBUG while enable AT OTA #########################
CONFIG_AT_OTA=y
CONFIG_FOTA_PIECE_SIZE=2048

#################################### Drivers Config ############################
CONFIG_SPIFLASH_DRV=y
CONFIG_GPIO_UART=y

################################### Misc #######################################
CONFIG_ARCH_ARM=y
CONFIG_CPU_CM0=y
CONFIG_CHIP_VENDOR_PHYPLUS=y
CONFIG_KERNEL_NO_MM=y
CONFIG_KERNEL_NO_DYN_ALLOC=y

#
# Chip options
#
CONFIG_CHIP_CH6121=y
CONFIG_CHIP_VENDOR_STR="phyplus"
CONFIG_CHIP_NAME_STR="ch6121"
CONFIG_BOARD_NAME_STR="ch6121_evb"
CONFIG_SUPPORT_TSPEND=y
#
# Rtos kernel options
#
CONFIG_KERNEL_RHINO=y
CONFIG_SYSTICK_HZ=1000
#
# OS support features
#
CONFIG_HAVE_VIC=y
CONFIG_ARCH_INTERRUPTSTACK=2048
CONFIG_DEBUG_LEVEL="-g"
CONFIG_OPTIMIZE_LEVEL="-Os"
CONFIG_IDLE_TASK_STACK_SIZE=512
CONFIG_KERNEL_TIMER_STACK_SIZE=2048
CONFIG_BLUETOOTH_WORK_QUEUE_STACK_SIZE=1024
CONFIG_BT_HCI_TX_STACK_SIZE=1536
CONFIG_BT_RX_STACK_SIZE=2048
CONFIG_BT_L2CAP_TX_BUF_COUNT=8
CONFIG_BT_ACL_RX_COUNT=4
CONFIG_BT_USE_MM=y
CONFIG_BT_CTLR_CRYPTO=y
################################### Bluetooth #######################################
##BT CONFIG
CONFIG_BT=y
CONFIG_BT_SMP=y
CONFIG_BT_BROADCASTER=y
CONFIG_SETTINGS=y
CONFIG_BT_SETTINGS=y
#CONFIG_BT_TINYCRYPT_ECC=y
CONFIG_BT_PERIPHERAL=y
CONFIG_BT_RECV_IS_RX_THREAD=y
CONFIG_BT_DEVICE_NAME_DYNAMIC=y
#CONFIG_BT_HCI_ACL_FLOW_CONTROL=y
#CONFIG_BT_PRIVACY=y
CONFIG_BT_SHELL=y
#CONFIG_BT_L2CAP_DYNAMIC_CHANNEL=y
#CONFIG_BT_SIGNING=y
#CONFIG_BT_ATT_PREPARE_COUNT=20
CONFIG_BT_L2CAP_RX_MTU=247
CONFIG_BT_L2CAP_TX_MTU=247
CONFIG_BT_MAX_PAIRED=3
##DEBUG OPTION
#CONFIG_BT_DEBUG_LOG=y
#CONFIG_BT_DEBUG=y
#CONFIG_BT_DEBUG_HCI_CORE=y
#CONFIG_BT_DEBUG_ATT=y
#CONFIG_BT_DEBUG_SMP=y
#CONFIG_BT_DEBUG_GATT=y
#CONFIG_BT_DEBUG_CONN=y
#CONFIG_BT_DEBUG_SETTINGS=y
#CONFIG_BT_DEBUG_KEYS=y
#CONFIG_UNITTEST_MODE=y
CONFIG_BT_ECC=y
```
